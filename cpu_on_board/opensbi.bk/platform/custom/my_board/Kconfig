## cpu_on_board/opensbi.bk/platform/custom/my_board/Kconfig
```kconfig
config PLATFORM_CUSTOM_MY_BOARD
    bool "My Custom FPGA RISC-V Board"
    default y
```

## create_mini_linux/buildroot-2026.02/ima_defconfig
```kconfig
BR2_riscv=y
BR2_RISCV_64=y
BR2_riscv_custom=y
BR2_RISCV_ISA_RVM=y
BR2_RISCV_ISA_RVA=y
BR2_RISCV_ISA_EXTRA="zicsr_zifencei_zalrsc_zaamo"
BR2_RISCV_ABI_LP64=y
BR2_TOOLCHAIN_BUILDROOT_MUSL=y
BR2_TARGET_ROOTFS_CPIO=y
BR2_STATIC_LIBS=y
```
